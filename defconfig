## defconfig
```kconfig
CONFIG_ESPTOOLPY_FLASHSIZE_4MB=y
CONFIG_ESPTOOLPY_HEADER_FLASHSIZE_UPDATE=y
CONFIG_SPEED_FRAMEWORK_ENABLED=y
CONFIG_SPEED_FRAMEWORK_USE_NETWORK=y
CONFIG_SPEED_FRAMEWORK_USE_MODBUS=y
CONFIG_COMPILER_STACK_CHECK_MODE_NORM=y
CONFIG_COMPILER_ORPHAN_SECTIONS_PLACE=y
CONFIG_BT_ENABLED=y
CONFIG_BT_NIMBLE_ENABLED=y
CONFIG_BT_NIMBLE_BLUFI_ENABLE=y
CONFIG_RMT_RECV_FUNC_IN_IRAM=y
CONFIG_UART_ISR_IN_IRAM=y
# CONFIG_ESP_WIFI_AMPDU_TX_ENABLED is not set
# CONFIG_ESP_WIFI_AMPDU_RX_ENABLED is not set
CONFIG_ESP_WIFI_TASK_PINNED_TO_CORE_1=y
CONFIG_LOG_DEFAULT_LEVEL_DEBUG=y
CONFIG_LOG_COLORS=y
```

## src/KConfig.projbuild
```kconfig
menu "Speed Framework"
  config SPEED_FRAMEWORK_ENABLED
    bool "Enabled"
    imply COMPILER_CXX_EXCEPTIONS
    imply COMPILER_CXX_RTTI
    help
      Enable the speed framework libraries
  menu "MQTT"
    depends on SPEED_FRAMEWORK_ENABLED
    config SPEED_FRAMEWORK_USE_MQTT
      bool "Use MQTT"
      help
        Enable the MQTT libary and apply default MQTT configuration to the board. 
  endmenu
  menu "BLE"
    depends on SPEED_FRAMEWORK_ENABLED
    config SPEED_FRAMEWORK_USE_BLE
      bool "Use BLE"
      imply BT_ENABLED
      imply BT_NIMBLE_ENABLED
      help
        Enable BLE support
    menu "BluFi"
      depends on SPEED_FRAMEWORK_USE_BLE
      config SPEED_FRAMEWORK_USE_BLUFI
        imply NIMBLE_BLUFI_ENABLE
        bool "Use BLUFI"
      config SPEED_FRAMEWORK_BLUFI_WIFI_CON_MAX_RETRY
        int "Wifi connection maximun retry attemps"
        depends on SPEED_FRAMEWORK_USE_BLUFI
        range 0 255
        default 2
        help
           WiFi connection maximum retry, from 0 to 255.
    endmenu
  endmenu
  menu "Settings"
    depends on SPEED_FRAMEWORK_ENABLED
    config SPEED_FRAMEWORK_USE_SETTINGS
      bool "Use Settings"
      help
        Enable settings library.
  endmenu
  menu "network"
    depends on SPEED_FRAMEWORK_ENABLED
    config SPEED_FRAMEWORK_USE_NETWORK
      bool "Use Network"
      help
        Enable network library.
    menu "Modbus"
      depends on SPEED_FRAMEWORK_USE_NETWORK
      config SPEED_FRAMEWORK_USE_MODBUS
        bool "Use Modbus"
        help
          Enable Modbus library.
    endmenu
  endmenu
endmenu
```
